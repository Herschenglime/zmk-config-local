/*
 * Copyright (c) 2020 The ZMK Contributors
 *
 * SPDX-License-Identifier: MIT
 */

#include <behaviors.dtsi>
#include <dt-bindings/zmk/keys.h>
#include <dt-bindings/zmk/bt.h>

#define DEFAULT 0
#define GAMING 1
#define NAV 2
#define SYM 3
#define NUM 4
#define BLUETOOTH 5

// define sets of layers such that certain combos can be excluded from callum mod layers
#define LEFT_EXCLUSION layers = <DEFAULT GAMING SYM NUM BLUETOOTH>;
#define RIGHT_EXCLUSION layers = <DEFAULT GAMING NAV NUM BLUETOOTH>;

// homerow mods macro
#define HRML &sk LALT  &sk LGUI  &sk LSFT &sk LCTL
#define HRMR &sk RCTL  &sk RSFT  &sk RGUI &sk LALT

/* Ex command to convert kp to autoshifted key
 *
 * :'<,'>s/\(\&kp \)\([A-Z]+\)/AS(\2)/g
 * */

&mt {
  //  flavor = "tap-preferred";
   // tapping_term_ms = <200>;
};

//give myself a bunch of time to stack modifiers
// https://zmk.dev/docs/keymaps/behaviors/sticky-key#quick-release
&sk {
     release-after-ms = <2000>;
     lazy;
     quick-release;
};

//allow for adding modifiers to keys on sticky num layer
// undo to allow summoning mods from sticky layers
// &sl {
//     /delete-property/ quick-release;
// };

&caps_word {
continue-list = <UNDERSCORE BSPC MINUS>;
};

#define AS(keycode) &as LS(keycode) keycode
/ {
    macros {
        summon_terminal: zed_em_kay {
            label = "ZM_summon_terminal";
            compatible = "zmk,behavior-macro";
            #binding-cells = <0>;
            bindings
                = <&macro_press &kp LGUI>
                , <&macro_tap &kp RET>
                , <&macro_release &kp LGUI>
                ;
        };

        ZMK_MACRO(my_macro,
            wait-ms = <30>;
            tap-ms = <40>;
            bindings = <&kp Z &kp M &kp K>;
        )
    };
};

/ {
    behaviors {
        as: auto_shift {
            compatible = "zmk,behavior-hold-tap";
            label = "AUTO_SHIFT";
            #binding-cells = <2>;
            tapping_term_ms = <145>;
            quick_tap_ms = <0>;
            flavor = "tap-preferred";
            bindings = <&kp>, <&kp>;
        };

        mo_tog: behavior_mo_tog {
            compatible = "zmk,behavior-hold-tap";
            label = "mo_tog";
            #binding-cells = <2>;
            flavor = "hold-preferred";
            tapping-term-ms = <200>;
            bindings = <&mo>, <&tog>;
        };

        /* sm: behavior_sticky_mo { */
        /*     compatible = "zmk,behavior-hold-tap"; */
        /*     label = "sticky_momentary"; */
        /*     #binding-cells = <2>; */
        /*     flavor = "hold-preferred"; */
        /*     tapping-term-ms = <200>; */
        /*     bindings = <&mo>, <&sl>; */
        /* }; */

        smt: behavior_sticky_mod_tap {
            compatible = "zmk,behavior-hold-tap";
            label = "sticky_mod_tap";
            #binding-cells = <2>;
            flavor = "hold-preferred";
            tapping-term-ms = <200>;
            bindings = <&sk>, <&kp>;
        };

        tph: tap-preferred-hold {
            compatible = "zmk,behavior-hold-tap";
            label = "tap preferred hold";
            #binding-cells = <2>;
            flavor = "tap-preferred";
            tapping-term-ms = <200>;
            bindings = <&kp>, <&kp>;
        };

    };

    combos {
        compatible = "zmk,combos";

        combo_del {
            timeout-ms = <50>;
            key-positions = <1 2>;
            bindings = <&kp DEL>;
        };

        // fire off mod so its easy to get to gnome menu
        combo_mod {
            timeout-ms = <50>;
            key-positions = <11 12 13>;
            bindings = <&kp LGUI>;
            LEFT_EXCLUSION
        };

         combo_backspace {
            timeout-ms = <30>;
            key-positions = <11 12>;
            bindings = <&kp BSPC>;
            LEFT_EXCLUSION
        };

         combo_esc {
            timeout-ms = <30>;
            key-positions = <21 22>;
            bindings = <&kp ESC>;
            LEFT_EXCLUSION
        };

         combo_double_quote {
            timeout-ms = <50>;
            key-positions = <7 8>;
            bindings = <&kp DOUBLE_QUOTES>;
        };

         combo_hyphen {
            timeout-ms = <50>;
            key-positions = <13 14>;
            bindings = <AS(MINUS)>;
        };

         combo_underscore {
            timeout-ms = <50>;
            key-positions = <23 24>;
            bindings = <&kp UNDERSCORE>;
        };

         combo_equals {
            timeout-ms = <50>;
            key-positions = <15 16>;
            bindings = <AS(EQUAL)>;
        };

         combo_plus {
            timeout-ms = <50>;
            key-positions = <25 26>;
            bindings = <&kp PLUS>;
        };

          combo_quote {
            timeout-ms = <50>;
            key-positions = <17 18>;
            bindings = <AS(SQT)>;
            RIGHT_EXCLUSION
        };

          // commented in favor of having a more accessible tab combo
        //   combo_double_quote {
        //     timeout-ms = <50>;
        //     key-positions = <27 28>;
        //     bindings = <&kp DOUBLE_QUOTES>;
        // };

          combo_tab {
            timeout-ms = <50>;
            key-positions = <27 28>;
            bindings = <&kp TAB>;
        };

          combo_reset {
            timeout-ms = <50>;
            key-positions = <1 2 7 8>;
            bindings = <&sys_reset>;
        };

          combo_bootloader {
            timeout-ms = <50>;
            key-positions = <3 4 5 6>;
            bindings = <&bootloader>;
        };

          combo_caps_word {
            timeout-ms = <50>;
            key-positions = <31 32>;
            bindings = <&caps_word>;
        };

        opening_brace {
            timeout-ms = <15>;
            key-positions = <2 3>;
            bindings = <&kp LBRC>;
        };

        closing_brace {
            timeout-ms = <15>;
            key-positions = <6 7>;
            bindings = <&kp RBRC>;
        };

        opening_par {
            timeout-ms = <15>;
            key-positions = <12 13>;
            bindings = <&kp LPAR>;
            LEFT_EXCLUSION
        };

        closing_par {
            timeout-ms = <15>;
            key-positions = <16 17>;
            bindings = <&kp RPAR>;
            RIGHT_EXCLUSION
        };

        opening_bracket {
            timeout-ms = <15>;
            key-positions = <22 23>;
            bindings = <&kp LBKT>;
        };

        closing_bracket {
            timeout-ms = <15>;
            key-positions = <26 27>;
            bindings = <&kp RBKT>;
        };

        ralt_left {
            timeout-ms = <30>;
            key-positions = <21 22 23>;
            bindings = <&kp RALT>;
        };

        ralt_right {
            timeout-ms = <30>;
            key-positions = <26 27 28>;
            bindings = <&kp RALT>;
        };

        // Hold ctrl for mouse input OR alt tab if tapped
        ctrl_alt_tab {
            timeout-ms = <50>;
            key-positions = <30 31>;
            bindings = <&mt LCTL LA(TAB)>;
        };

        // Hold alt for mouse input OR alt tab if tapped
        alt_mod_tab {
            timeout-ms = <50>;
            key-positions = <32 33>;
            bindings = <&mt LALT LG(TAB)>;
        };

        gaming_time {
            timeout-ms = <50>;
            key-positions = <2 11 13>;
            bindings = <&tog GAMING>;
        };

        all_thumbs {
            timeout-ms = <50>;
            key-positions = <30 31 32 33>;
            bindings = <&kp LG(LC(RET))>;
        };

        summon_terminal {
            timeout-ms = <50>;
            key-positions = <16 17 18>;
            bindings = <&kp LG(LA(T))>;
        };

        zmk_tester {
            timeout-ms = <50>;
            key-positions = <1 2 3>;
            bindings = <&my_macro>;
        };

        bluetooth_layer {
            timeout-ms = <50>;
            key-positions = <0 10 20>;
            bindings = <&tog BLUETOOTH>;
        };
    };

    conditional_layers {
        compatible = "zmk,conditional-layers";
        tri_layer {
            if-layers = <NAV SYM>;
            then-layer = <NUM>;
        };
    };

keymap {
compatible = "zmk,keymap";
/*
                                                 reset
                           ┌─────┬─────────────────┴─────────────────┬─────┐
                           │     │                                   │     │
                           │     │            bootloader             │     │
                           │     │     ┌─────┬─────┴─────┬─────┐     │     │
                  |  q  |  w  |  f  |  p  |  b  |     |  j  |  l  |  u  |  y  |  ;  |
                  |     |    DEL    |     |     |     |     |     |     |     \     |

                  |  a  |  r  |  s  |  t  |  g  |     |  m  |  n  |  e  |  i  |  o  |
                  |     |     |     |     |     |     |     |     |     |     '     |
                  |     |    BSP    |     -     |     |     =     |     |     |     |

                  |  z  |  x  |  c  |  d  |  v  |     |  k  |  h  |  ,  |  .  |  /  |
                  |     |     |     |     _     |     |     +     |     |     |     |

                                    | nav | spc |     | ent | sym |
                                    |     | sft |     | mod |     |
                                             └─────┬─────┘
                                               caps_word

*/

                default_layer {
        bindings = <
        AS(Q) AS(W) AS(F) AS(P) AS(B)                      AS(J) AS(L)  AS(U)    AS(Y)   AS(SEMI)
        AS(A) AS(R) AS(S) AS(T) AS(G)                      AS(M) AS(N) AS(E) AS(I) AS(O)
        AS(Z) AS(X) AS(C) AS(D) AS(V)                      AS(K) AS(H)  AS(CMMA) AS(DOT)  AS(FSLH)
                &mo NAV &tph LSFT SPC                      &tph LGUI RET &mo SYM
        >;
        };

                gaming_layer {
        bindings = <
    &kp TAB  &kp Q  &kp W  &kp E  &kp R      &kp Y  &kp U  &kp I  &kp O  &kp P

    &kp LSFT  &kp A  &kp S  &kp D  &kp F      &kp H  &kp J  &kp K  &kp L  &kp SQT

    &kp LCTL  &kp Z  &kp X  &kp C  &kp V      &kp N  &kp M  &kp COMMA  &kp DOT    &kp FSLH

                 &kp SPC  &kp ESC      &kp ESC    &kp SPACE
        >;
        };


                nav_layer {
        bindings = <
   &trans  &trans  &trans  &trans  &trans                 &trans  &kp HOME  &kp PG_DN  &kp PG_UP  &kp END

            HRML                   &trans                 &trans  &kp LEFT &kp DOWN &kp UP &kp RIGHT

   &kp LC(Z) &kp  LC(X)  &kp LC(C)  &kp ESC  &kp LC(V)    &trans  &kp TAB  &kp LC(MINUS)  &kp LC(EQUAL) &trans

                                        &trans  &trans    &trans  &trans
        >;
        };


                sym_layer {
        bindings = <
    &kp EXCL  &kp AT  &kp HASH  &kp DLLR  &kp PRCNT           &trans  &trans  &trans  &trans  &trans

    &kp SLASH  &kp ASTRK  &kp MINUS  &kp PLUS  &trans        &trans  HRMR

    &kp CARET &kp AMPS  AS(GRAVE)  AS(BSLH)  &trans           &trans  &kp TAB  &kp C_VOL_DN &kp C_VOL_UP  &kp C_PP

                             &trans  &trans                  &trans  &trans
        >;
        };

                num_layer {
        bindings = <
    &kp F1 &kp F2 &kp F3 &kp F4    &kp INS              &kp DEL &kp N7 &kp N8 &kp N9 AS(SEMI)
    &kp F5 &kp F6 &kp F7 &kp F8    &kp PSCRN            &kp BSPC &kp N4 &kp N5 &kp N6 &kp N0
    &kp F9 &kp F10 &kp F11 &kp F12 &bootloader          &kp COMMA &kp N1 &kp N2 &kp N3 &kp DOT
                         &trans &trans                  &trans &trans
        >;
        };

                bluetooth_layer {
        bindings = <
    &trans &trans &trans &trans &trans      &trans &trans &trans &trans &trans
    &trans &trans &trans &trans &trans      &trans &bt BT_SEL 0 &bt BT_SEL 1 &bt BT_SEL 2 &bt BT_SEL 3
    &trans &trans &trans &trans &trans      &trans &bt BT_SEL 4 &bt BT_CLR &studio_unlock &trans
                         &trans &trans      &trans &trans
        >;
        };
};
  };
/*
};

// empty layers for easy creation later

/*
                |     |     |     |     |     |        |     |     |     |     |     |

                |     |     |     |     |     |        |     |     |     |     |     |

                |     |     |     |     |     |        |     |     |     |     |     |

                                  |     |     |        |     |     |
*/

/*
                empty_layer {
        bindings = <
    &trans &trans &trans &trans &trans      &trans &trans &trans &trans &trans
    &trans &trans &trans &trans &trans      &trans &trans &trans &trans &trans
    &trans &trans &trans &trans &trans      &trans &trans &trans &trans &trans
                         &trans &trans      &trans &trans
        >;
        };
*/
